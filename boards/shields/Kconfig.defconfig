## boards/shields/Kconfig.defconfig
```kconfig
if SHIELD_MY_KEYBOARD_LEFT


config ZMK_KEYBOARD_NAME
    default "MooseAntlers"

config ZMK_SPLIT_ROLE_CENTRAL
    default y

endif

if SHIELD_MY_KEYBOARD_LEFT || SHIELD_MY_KEYBOARD_RIGHT

config ZMK_SPLIT
    default y

endif
```

## west.yml
```yaml
manifest:
  remotes:
    - name: zmkfirmware
      url-base: https://github.com/zmkfirmware
    - name: oORiggsOo
      url-base: https://github.com/oORiggsOo
    - name: MooseAntlers
      url-base: https://github.com/MooseAntlers
  projects:
    - name: zmk
      remote: zmkfirmware
      revision: main
      import: app/west.yml
    - name: ec-support-zmk-module
      remote: MooseAntlers
      revision: main
    - name: MooseAntlers
      remote: MooseAntlers
      revision: main
  self:
    path: config
```
